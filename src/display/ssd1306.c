#include "ssd1306.h"
#include <string.h>
#include "driver/i2c.h"
#include "freertos/FreeRTOS.h"
#include "freertos/task.h"
#define I2C_MASTER_NUM      I2C_NUM_0
#define I2C_MASTER_SDA_IO   21
#define I2C_MASTER_SCL_IO   22
#define I2C_MASTER_FREQ_HZ  400000
#define OLED_ADDR           0x3C

static const uint8_t font5x7[][5] = {
    {0x00,0x00,0x00,0x00,0x00}, // space
    {0x00,0x00,0x5F,0x00,0x00}, // !
    {0x00,0x07,0x00,0x07,0x00}, // "
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    {0x61,0x51,0x49,0x45,0x43}, // Z
};
static void oled_send_cmd(uint8_t cmd) {
    uint8_t buf[2] = {0x00, cmd};
    i2c_master_write_to_device(I2C_MASTER_NUM, OLED_ADDR, buf, 2, pdMS_TO_TICKS(100));
}

static void oled_send_data(uint8_t *data, size_t len) {
    uint8_t buf[len + 1];
    buf[0] = 0x40;
    memcpy(buf + 1, data, len);
    i2c_master_write_to_device(I2C_MASTER_NUM, OLED_ADDR, buf, len + 1, pdMS_TO_TICKS(100));
}
void oled_init(void) {
    // init I2C bus
    i2c_config_t conf = {
        .mode             = I2C_MODE_MASTER,
        .sda_io_num       = I2C_MASTER_SDA_IO,
        .scl_io_num       = I2C_MASTER_SCL_IO,
        .sda_pullup_en    = GPIO_PULLUP_ENABLE,
        .scl_pullup_en    = GPIO_PULLUP_ENABLE,
        .master.clk_speed = I2C_MASTER_FREQ_HZ,
    };
    i2c_param_config(I2C_MASTER_NUM, &conf);
    i2c_driver_install(I2C_MASTER_NUM, conf.mode, 0, 0, 0);

    // wake up the OLED
    uint8_t init_cmds[] = {
        0xAE,       // display off
        0xD5, 0x80, // clock divide
        0xA8, 0x3F, // multiplex ratio
        0xD3, 0x00, // display offset
        0x40,       // start line
        0x8D, 0x14, // charge pump on
        0x20, 0x00, // horizontal addressing
        0xA1,       // segment remap
        0xC8,       // COM scan direction
        0xDA, 0x12, // COM pins
        0x81, 0xCF, // contrast
        0xD9, 0xF1, // pre-charge
        0xDB, 0x40, // vcomh
        0xA4,       // display from RAM
        0xA6,       // normal display
        0xAF,       // display ON
    };
    for (int i = 0; i < sizeof(init_cmds); i++)
        oled_send_cmd(init_cmds[i]);
}

void oled_clear(void) {
    uint8_t blank[128] = {0};
    for (int page = 0; page < 8; page++) {
        oled_send_cmd(0xB0 + page);
        oled_send_cmd(0x00);
        oled_send_cmd(0x10);
        oled_send_data(blank, 128);
    }
}

void oled_print(uint8_t page, uint8_t col, const char *str) {
    oled_send_cmd(0xB0 + page);
    oled_send_cmd(0x00 + (col & 0x0F));
    oled_send_cmd(0x10 + (col >> 4));

    while (*str) {
        char c = *str++;
        if (c < 32 || c > 90) c = 32;
        uint8_t glyph[6];
        memcpy(glyph, font5x7[c - 32], 5);
        glyph[5] = 0x00;
        oled_send_data(glyph, 6);
    }
}